## conf/machine/orangepi-zero3.conf
```bitbake
#@TYPE: Machine
#@NAME: orange-pi-zero-3
#@DESCRIPTION: Machine configuration for the Orange Pi Zero 3, based on Allwinner H618 CPU

require conf/machine/include/sun50i-h616.inc

KERNEL_DEVICETREE = "allwinner/sun50i-h618-orangepi-zero3.dtb"

UBOOT_MACHINE = "orangepi_zero3_defconfig"

SPL_BINARY = "u-boot-sunxi-with-spl.bin"

MACHINE_FEATURES:remove = "alsa x11"
MACHINE_FEATURES:append = " bluetooth wifi"

MACHINE_EXTRA_RRECOMMENDS = "uwe5622-firmware"

KERNEL_MODULE_AUTOLOAD += " sprdwl_ng sprdbt_tty "

IMAGE_BOOT_FILES = " \
    ${KERNEL_IMAGETYPE} \
    boot.scr \
    ${@d.getVar('KERNEL_DEVICETREE', '').split('/')[-1]};allwinner/${@d.getVar('KERNEL_DEVICETREE', '').split('/')[-1]} \
"
```
